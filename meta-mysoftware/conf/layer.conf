## meta-mysoftware/conf/layer.conf
```bitbake
# We have a conf and classes directory, append to BBPATH
BBPATH .= ":${LAYERDIR}"

# We have recipes-* directories, add to BBFILES
BBFILES += "${LAYERDIR}/recipes-*/*/*.bb \
            ${LAYERDIR}/recipes-*/*/*.bbappend"

BBFILE_COLLECTIONS += "mysoftware"
BBFILE_PATTERN_mysoftware = "^${LAYERDIR}/"
BBFILE_PRIORITY_mysoftware = "10"

LAYERDEPENDS_mysoftware = "core"
LAYERSERIES_COMPAT_mysoftware = "kirkstone"
```
